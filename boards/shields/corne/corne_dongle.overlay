/*
 * Copyright (c) 2020 The ZMK Contributors
 *
 * SPDX-License-Identifier: MIT
 */

#include <dt-bindings/zmk/matrix_transform.h>

/ {
    chosen {
        zmk,kscan = &kscan0;
        zmk,matrix_transform = &default_transform;
    };

    kscan0: kscan {
        compatible = "zmk,kscan-gpio-direct";
        label = "KSCAN";
        
        input-gpios
            = <&pro_micro 0 (GPIO_ACTIVE_LOW | GPIO_PULL_UP)>
            ;
    };
};

&default_transform {
    col-offset = <6>;
};